#pragma once

#include "wled.h"
#include "light_alarm_sync.h"
#ifdef ARDUINO_ARCH_ESP32
#include <nvs.h>
#endif

// AI: below section was generated by an AI
namespace LightAlarm {

// Keep the independently owned schedules and their ordering/execution markers in one NVS
// value without rewriting the manual schedule or other WLED settings.
// Reference: https://docs.espressif.com/projects/esp-idf/en/v5.5.1/esp32/api-reference/storage/nvs_flash.html
class PhoneSyncStore {
public:
  static constexpr size_t MAX_SIZE = 10000;
  static constexpr bool supported() {
#ifdef ARDUINO_ARCH_ESP32
    return true;
#else
    return false;
#endif
  }

  // A missing namespace/key is a fresh, disabled slot; a corrupt existing blob is
  // never silently reset, and does not disable the independent manual schedule.
  bool load(PhoneSyncRecord& candidate, bool& migration, const char*& error) {
    migration = false;
#ifdef ARDUINO_ARCH_ESP32
    nvs_handle_t handle;
    esp_err_t status = nvs_open("weckersync", NVS_READONLY, &handle);
    if (status == ESP_ERR_NVS_NOT_FOUND) return true;
    if (status != ESP_OK) { error = "sync_storage_unavailable"; return false; }
    size_t size = 0;
    status = nvs_get_blob(handle, "state", nullptr, &size);
    if (status == ESP_ERR_NVS_NOT_FOUND) { nvs_close(handle); return true; }
    char* data = status == ESP_OK && size && size <= MAX_SIZE ? static_cast<char*>(d_malloc(size + 1)) : nullptr;
    if (status == ESP_OK && size && size <= MAX_SIZE && !data) { nvs_close(handle); error = "low_memory"; return false; }
    const bool readable = data && nvs_get_blob(handle, "state", data, &size) == ESP_OK;
    nvs_close(handle);
    if (!readable) { p_free(data); error = "sync_configuration_unreadable"; return false; }
    data[size] = '\0';
    if (!requestJSONBufferLock(JSON_LOCK_LIGHT_ALARM)) { p_free(data); error = "busy"; return false; }
    const bool ok = validSyncJsonEnvelope(data, size) && !deserializeJson(*pDoc, data, size, DeserializationOption::NestingLimit(4)) &&
      pDoc->is<JsonObject>() && parsePhoneSyncRecord(pDoc->as<JsonObjectConst>(), candidate, error);
    migration = ok && (*pDoc)["version"] == 1;
    pDoc->clear();
    releaseJSONBufferLock();
    memset(data, 0, size + 1);
    p_free(data);
    if (!ok && !error[0]) error = "sync_configuration_unreadable";
    return ok;
#else
    (void)candidate; (void)error;
    return true;
#endif
  }

  // Replace one NVS value containing settings, ordering and execution state.
  // A failed commit never updates the live RAM record or acknowledges success.
  bool save(const PhoneSyncRecord& candidate, const char*& error) {
#ifdef ARDUINO_ARCH_ESP32
    if (!requestJSONBufferLock(JSON_LOCK_LIGHT_ALARM)) { error = "busy"; return false; }
    serializePhoneSyncRecord(pDoc->to<JsonObject>(), candidate);
    const size_t size = measureJson(*pDoc);
    // Allocate the measured payload, not a maximum-sized buffer on Arduino's stack.
    char* data = !pDoc->overflowed() && size <= MAX_SIZE ? static_cast<char*>(d_malloc(size + 1)) : nullptr;
    const bool encoded = data && serializeJson(*pDoc, data, size + 1) == size;
    pDoc->clear();
    releaseJSONBufferLock();
    if (!encoded) { p_free(data); error = "low_memory"; return false; }
    nvs_handle_t handle;
    esp_err_t status = nvs_open("weckersync", NVS_READWRITE, &handle);
    if (status == ESP_OK) {
      status = nvs_set_blob(handle, "state", data, size);
      if (status == ESP_OK) status = nvs_commit(handle);
      nvs_close(handle);
    }
    memset(data, 0, size + 1);
    p_free(data);
    if (status != ESP_OK) { error = "sync_storage_failed"; return false; }
    return true;
#else
    (void)candidate;
    error = "sync_unsupported";
    return false;
#endif
  }
};

} // namespace LightAlarm
// AI: end
