#pragma once

#include "wled.h"
#include "light_alarm_model.h"
#include "light_alarm_atomic.h"

// AI: below section was generated by an AI
namespace LightAlarm {

class WledAdapter {
  struct SegmentState {
    uint32_t colors[NUM_COLORS];
    uint16_t start, stop, startY, stopY;
    uint8_t mode, palette, speed, intensity, opacity, cct, custom1, custom2, custom3;
    bool on, check1, check2, check3;
  };
  SegmentState _previous[MAX_NUM_SEGMENTS];
  uint8_t _count = 0, _previousBri = 0, _previousPreset = 0;
  uint8_t _fx = FX_MODE_STATIC, _palette = 0, _speed = DEFAULT_SPEED, _intensity = DEFAULT_INTENSITY;
  uint8_t _custom1 = DEFAULT_C1, _custom2 = DEFAULT_C2, _custom3 = DEFAULT_C3;
  bool _check1 = false, _check2 = false, _check3 = false;
  uint32_t _colors[NUM_COLORS] = {0};
  bool _owned = false;
  Atomic<bool> _writing {false}, _interrupted {false};

  static uint32_t sunriseColor(uint8_t blend, uint8_t white, bool hasWhite) {
    const uint8_t w = hasWhite ? white : 0;
    const uint32_t end = RGBW32(255 - w, (255 - w) * 200 / 255, (255 - w) * 120 / 255, w);
    return color_blend(RGBW32(255, 36, 0, 0), end, blend);
  }

  void completeUpdate(uint16_t transition) {
    stateUpdated(CALL_MODE_NO_NOTIFY);
    strip.setTransition(transition);
    _writing = false;
  }

public:
  // A user/core state change relinquishes ownership without undoing the new state.
  void stateChangedExternally() { if (!_writing.load()) _interrupted = true; }
  bool interrupted() { return _interrupted.exchange(false); }

  // Read visual fields only: a preset must not execute macros, playlists or usermod
  // commands behind the alarm's back. Preserve the installation's segment geometry.
  bool begin(const Alarm& alarm, bool preview, bool& fallback, const char*& error) {
    if (realtimeMode && !realtimeOverride) { error = "realtime_active"; return false; }
    if (preview && (nightlightActive || currentPlaylist >= 0)) { error = "preview_conflicts_with_timer_or_playlist"; return false; }
    _count = min(uint8_t(MAX_NUM_SEGMENTS), strip.getSegmentsNum());
    bool hasSegment = false;
    for (uint8_t i = 0; i < _count; ++i) {
      const Segment& segment = strip.getSegment(i);
      SegmentState& saved = _previous[i];
      hasSegment |= segment.isActive();
      saved.start = segment.start; saved.stop = segment.stop;
      saved.startY = segment.startY; saved.stopY = segment.stopY;
      for (unsigned c = 0; c < NUM_COLORS; ++c) saved.colors[c] = segment.colors[c];
      saved.mode = segment.mode; saved.palette = segment.palette;
      saved.speed = segment.speed; saved.intensity = segment.intensity;
      saved.opacity = segment.opacity; saved.cct = segment.cct;
      saved.on = segment.getOption(SEG_OPTION_ON);
      saved.custom1 = segment.custom1; saved.custom2 = segment.custom2; saved.custom3 = segment.custom3;
      saved.check1 = segment.check1; saved.check2 = segment.check2; saved.check3 = segment.check3;
    }
    if (!hasSegment) { error = "no_active_led_segment"; return false; }
    _previousBri = bri;
    _previousPreset = currentPreset;
    _fx = FX_MODE_STATIC; _palette = 0; _speed = DEFAULT_SPEED; _intensity = DEFAULT_INTENSITY;
    _custom1 = DEFAULT_C1; _custom2 = DEFAULT_C2; _custom3 = DEFAULT_C3;
    _check1 = _check2 = _check3 = false;
    fallback = false;
    if (alarm.scene == Scene::Preset) {
      if (!requestJSONBufferLock(JSON_LOCK_LIGHT_ALARM)) { error = "busy"; return false; }
      bool found = readObjectFromFileUsingId(getPresetsFileName(), alarm.preset, pDoc);
      JsonVariant scene = (*pDoc)["seg"];
      JsonObject visual;
      if (scene.is<JsonArray>()) {
        for (JsonObject item : scene.as<JsonArray>()) {
          if (!item["col"].isNull() || !item["fx"].isNull()) { visual = item; break; }
        }
      } else if (scene.is<JsonObject>()) visual = scene.as<JsonObject>();
      found = found && !visual.isNull();
      if (found) {
        _fx = visual["fx"] | uint8_t(FX_MODE_STATIC);
        _palette = visual["pal"] | 0;
        _speed = visual["sx"] | uint8_t(DEFAULT_SPEED);
        _intensity = visual["ix"] | uint8_t(DEFAULT_INTENSITY);
        _custom1 = visual["c1"] | uint8_t(DEFAULT_C1);
        _custom2 = visual["c2"] | uint8_t(DEFAULT_C2);
        _custom3 = constrain(visual["c3"] | int(DEFAULT_C3), 0, 31); // Match deserializeSegment().
        _check1 = visual["o1"] | false;
        _check2 = visual["o2"] | false;
        _check3 = visual["o3"] | false;
        for (unsigned c = 0; c < NUM_COLORS; ++c) {
          JsonArray color = visual["col"][c];
          _colors[c] = color.isNull() ? (c ? BLACK : RGBW32(255, 180, 100, 0)) :
            RGBW32(constrain(color[0].as<int>(), 0, 255), constrain(color[1].as<int>(), 0, 255),
                   constrain(color[2].as<int>(), 0, 255), constrain(color[3].as<int>(), 0, 255));
        }
      }
      releaseJSONBufferLock();
      fallback = !found;
    }
    _writing = true;
    nightlightActive = false;
    handleNightlight(); // Let WLED restore an old Sunrise nightlight before taking over.
    unloadPlaylist();
    const uint16_t transition = strip.getTransition();
    strip.setTransition(0);
    for (uint8_t i = 0; i < _count; ++i) {
      Segment& segment = strip.getSegment(i);
      if (!segment.isActive()) continue;
      segment.setMode(_fx).setPalette(_palette).setOpacity(255).setOption(SEG_OPTION_ON, true);
      segment.speed = _speed; segment.intensity = _intensity;
      segment.custom1 = _custom1; segment.custom2 = _custom2; segment.custom3 = _custom3;
      segment.check1 = _check1; segment.check2 = _check2; segment.check3 = _check3;
      stateChanged = true;
      if (alarm.scene == Scene::Preset && !fallback) {
        for (unsigned c = 0; c < NUM_COLORS; ++c) segment.setColor(c, _colors[c]);
      }
    }
    bri = 0; // Never flash a bright preset before the first ramp frame.
    completeUpdate(transition);
    _owned = true;
    _interrupted = false;
    return true;
  }

  // The ordinary WLED renderer and brightness limiter still produce every LED frame.
  // No pixel buffer allocations or JSON work happens in this periodic update.
  bool render(const Alarm& alarm, const Frame& frame, bool fallback) {
    if (!_owned) return false;
    if (strip.getSegmentsNum() != _count || (realtimeMode && !realtimeOverride)) return false;
    for (uint8_t i = 0; i < _count; ++i) {
      const Segment& segment = strip.getSegment(i);
      const SegmentState& saved = _previous[i];
      if (segment.start != saved.start || segment.stop != saved.stop || segment.startY != saved.startY || segment.stopY != saved.stopY) return false;
    }
    _writing = true;
    const uint16_t transition = strip.getTransition();
    strip.setTransition(0);
    if (alarm.scene == Scene::Sunrise || fallback) {
      for (uint8_t i = 0; i < _count; ++i) {
        Segment& segment = strip.getSegment(i);
        if (segment.isActive()) segment.setColor(0, sunriseColor(frame.blend, alarm.white, segment.hasWhite()));
      }
    }
    bri = frame.brightness;
    completeUpdate(transition);
    return true;
  }

  // Restore a preview's visual state; ordinary alarms finish dark. Manual changes
  // skip restoration so the old preview/alarm never overwrites the user's action.
  void release(bool restorePreview, bool turnOff) {
    if (!_owned) return;
    _owned = false;
    if (!restorePreview && !turnOff) return;
    _writing = true;
    const uint16_t transition = strip.getTransition();
    strip.setTransition(0);
    if (restorePreview && strip.getSegmentsNum() == _count) {
      for (uint8_t i = 0; i < _count; ++i) {
        Segment& segment = strip.getSegment(i);
        const SegmentState& saved = _previous[i];
        if (!segment.isActive() || segment.start != saved.start || segment.stop != saved.stop) continue;
        segment.setMode(saved.mode).setPalette(saved.palette).setOpacity(saved.opacity).setCCT(saved.cct).setOption(SEG_OPTION_ON, saved.on);
        segment.speed = saved.speed; segment.intensity = saved.intensity;
        segment.custom1 = saved.custom1; segment.custom2 = saved.custom2; segment.custom3 = saved.custom3;
        segment.check1 = saved.check1; segment.check2 = saved.check2; segment.check3 = saved.check3;
        for (unsigned c = 0; c < NUM_COLORS; ++c) segment.setColor(c, saved.colors[c]);
      }
      bri = _previousBri;
    } else bri = 0;
    completeUpdate(transition);
    if (restorePreview) currentPreset = _previousPreset;
  }
};

} // namespace LightAlarm
// AI: end
