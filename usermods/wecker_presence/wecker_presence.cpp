#include "wecker_presence.h"
#ifdef ARDUINO_ARCH_ESP32
#include <esp_random.h>
#endif

#ifndef WLED_DISABLE_WECKER
// AI: below section was generated by an AI
using namespace LightAlarm;

const char WeckerPresenceUsermod::_name[] PROGMEM = "wecker_presence";
static WeckerPresenceUsermod weckerPresence;
REGISTER_USERMOD(weckerPresence);

namespace {
const Clock WLED_CLOCK {wledUtcToLocal, wledLocalToUtc};

const char* presenceName(Presence state) {
  return state == Presence::Present ? "present" : state == Presence::Absent ? "absent" : "unknown";
}

const char* phaseName(Phase phase) {
  switch (phase) {
    case Phase::Rising: return "rising";
    case Phase::Holding: return "holding";
    case Phase::Fading: return "fading";
    case Phase::Snoozed: return "snoozed";
    case Phase::Finished: return "finished";
    default: return "idle";
  }
}

const char* monitoringName(Monitoring mode) {
  switch (mode) {
    case Monitoring::Scheduled: return "scheduled";
    case Monitoring::BeforeAlarm: return "before_alarm";
    case Monitoring::Running: return "running";
    default: return "paused";
  }
}

bool unlocked() { return !settingsPIN[0] || correctPIN; }

void sendError(AsyncWebServerRequest* request, uint16_t code, const char* error) {
  char response[160];
  // Error codes are internal literals, never request-derived format/HTML strings.
  snprintf(response, sizeof(response), "{\"error\":\"%s\"}", error);
  request->send(code, FPSTR(CONTENT_TYPE_JSON), response);
}

// Strict small unsigned query values; no narrowing or array access before validation.
bool logQueryNumber(const String& value, uint8_t maximum, uint8_t& number) {
  if (!value.length() || value.length() > 3) return false;
  unsigned parsed = 0;
  for (unsigned i = 0; i < value.length(); ++i) {
    if (value[i] < '0' || value[i] > '9') return false;
    parsed = parsed * 10 + value[i] - '0';
  }
  if (parsed > maximum) return false;
  number = parsed;
  return true;
}

void serializeProbeLog(JsonObject object, const PresenceProvider::RoundLog& entry) {
  object["timeLocal"] = entry.localTime;
  object["durationMs"] = entry.durationMs;
  object["udpAttempts"] = entry.udpAttempts;
  if (entry.replyDelayMs == UINT32_MAX) object["replyDelayMs"] = nullptr;
  else object["replyDelayMs"] = entry.replyDelayMs;
  object["methods"] = entry.methods;
  object["result"] = entry.result == Presence::Present ? "reply" : entry.result == Presence::Absent ? "no_response" : "unconfirmed";
  object["manual"] = entry.manual;
  object["error"] = entry.error;
}
}

bool WeckerPresenceUsermod::clockValid() const {
  return toki.getTimeSource() >= TOKI_TS_SEC && validDate(epochDate(toki.second()));
}

void WeckerPresenceUsermod::setup() {
  if (!_mutex.begin()) return;
#ifdef ARDUINO_ARCH_ESP32
  // An opaque, non-secret epoch keeps a reboot's recycled job counter from
  // confirming an earlier boot's sync. It is not an access credential.
  uint32_t bootParts[2];
  esp_fill_random(bootParts, sizeof(bootParts));
  snprintf(_bootId, sizeof(_bootId), "%08lx%08lx", static_cast<unsigned long>(bootParts[0]), static_cast<unsigned long>(bootParts[1]));
#endif
  _ready = true;
  _presence.begin();
  loadConfiguration();
  loadPhoneConfiguration();
  publishConfiguration();
  publishStatus();
  registerRoutes();
}

void WeckerPresenceUsermod::loadConfiguration() {
  _candidate = Config();
  _candidate.enabled = _legacyEnabled;
  strlcpy(_candidate.presenceHost, _legacyHost, sizeof(_candidate.presenceHost));
  const char* error = "";
  if (!_store.load(_candidate, _legacy, error)) {
    _legacy = false;
    _configurationValid = false;
    _storageError = error;
    // Busy can be retried. A damaged file remains untouched and is shown in the UI.
    _loaded = strcmp(error, "busy") != 0;
    return;
  }
  _config = _candidate;
  _publishedRevision = _config.revision;
  _configurationValid = true;
  _configurationDirty = true;
  _loaded = true;
  _storageError = "";
  _presence.configure(_config.presenceHost, false); // No unsolicited probes when there is no upcoming alarm.
}

void WeckerPresenceUsermod::registerRoutes() {
  server.on(F("/wecker.json"), HTTP_GET, [this](AsyncWebServerRequest* request) { sendSnapshot(request, false); });
  server.on(F("/wecker/status"), HTTP_GET, [this](AsyncWebServerRequest* request) { sendSnapshot(request, true); });
  // Compatibility URL is now read-only; refreshing status must not start a probe.
  server.on(F("/wecker/presence"), HTTP_GET, [this](AsyncWebServerRequest* request) { sendSnapshot(request, true); });
  server.on(F("/wecker/result"), HTTP_GET, [this](AsyncWebServerRequest* request) { sendResult(request); });
  server.on(F("/wecker/log"), HTTP_GET, [this](AsyncWebServerRequest* request) { sendProbeLog(request); });
  // AsyncWebServer also matches descendants of an on() path. Exact filters keep
  // /profile, /alarms and /result out of the base sync handler, including on GET requests.
  server.on(F("/wecker/sync/iphone/alarms"), HTTP_GET, [this](AsyncWebServerRequest* request) { sendPhoneSnapshot(request, false, true); })
    .setFilter([](AsyncWebServerRequest* request) { return request->url() == F("/wecker/sync/iphone/alarms"); });
  server.on(F("/wecker/sync/iphone/profile"), HTTP_GET, [this](AsyncWebServerRequest* request) { sendPhoneSnapshot(request, true); })
    .setFilter([](AsyncWebServerRequest* request) { return request->url() == F("/wecker/sync/iphone/profile"); });
  server.on(F("/wecker/sync/iphone/result"), HTTP_GET, [this](AsyncWebServerRequest* request) { sendResult(request, true); })
    .setFilter([](AsyncWebServerRequest* request) { return request->url() == F("/wecker/sync/iphone/result"); });
  server.on(F("/wecker/sync/iphone"), HTTP_GET, [this](AsyncWebServerRequest* request) { sendPhoneSnapshot(request, false); })
    .setFilter([](AsyncWebServerRequest* request) { return request->url() == F("/wecker/sync/iphone"); });
  for (RequestKind kind : {RequestKind::Config, RequestKind::Control, RequestKind::PhoneProfile, RequestKind::PhoneSync, RequestKind::PhoneAlarms}) {
    const __FlashStringHelper* path = kind == RequestKind::Config ? F("/wecker.json") :
      kind == RequestKind::Control ? F("/wecker/control") : kind == RequestKind::PhoneSync ? F("/wecker/sync/iphone") :
      kind == RequestKind::PhoneAlarms ? F("/wecker/sync/iphone/alarms") :
      F("/wecker/sync/iphone/profile");
    AsyncCallbackWebHandler& handler = server.on(path, HTTP_POST,
      [this, kind](AsyncWebServerRequest* request) { enqueue(request, kind); }, nullptr,
      [this, kind](AsyncWebServerRequest* request, uint8_t* data, size_t len, size_t index, size_t total) {
        receiveBody(request, kind, data, len, index, total);
      });
    if (kind >= RequestKind::PhoneSync) handler.setFilter([path](AsyncWebServerRequest* request) { return request->url() == path; });
  }
}

// Explicit home-network trust policy: no token, login or PIN for the new sync API.
// This is a subnet restriction, not a person/device identity check. Existing core
// and manual-alarm routes retain their previous configured access policy.
bool WeckerPresenceUsermod::localSyncRequest(AsyncWebServerRequest* request) {
  return request->client() && localSyncPeer(uint32_t(request->client()->remoteIP()),
    uint32_t(WLEDNetwork.localIP()), uint32_t(WLEDNetwork.subnetMask()));
}

bool WeckerPresenceUsermod::authorize(AsyncWebServerRequest* request, RequestKind kind) {
  return kind >= RequestKind::PhoneSync ? localSyncRequest(request) : unlocked();
}

size_t WeckerPresenceUsermod::requestLimit(RequestKind kind) {
  return kind == RequestKind::Config ? Store::MAX_FILE_SIZE : kind == RequestKind::PhoneAlarms ? PHONE_LIST_MAX_BODY :
    kind == RequestKind::PhoneProfile ? 1024 : 512;
}

// A request owns its bounded upload buffer until ownership transfers to the queue.
// Disconnects before completion are cleaned up by AsyncWebServer's _tempObject lifecycle.
void WeckerPresenceUsermod::receiveBody(AsyncWebServerRequest* request, RequestKind kind, uint8_t* data, size_t len, size_t index, size_t total) {
  if (!authorize(request, kind) || !total || total > requestLimit(kind)) return;
  if (kind >= RequestKind::PhoneSync && !PhoneSyncStore::supported()) return;
  if (index == 0 && !request->_tempObject) {
    if (getFreeHeapSize() < total + sizeof(Body) + MIN_HEAP_SIZE + 4096) return;
    Body* body = static_cast<Body*>(d_malloc(sizeof(Body) + total + 1));
    if (!body) return;
    body->received = 0; body->total = total; body->invalid = false;
    request->_tempObject = body;
  }
  Body* body = static_cast<Body*>(request->_tempObject);
  if (!body) return;
  if (body->total != total || body->received != index || index > total || len > total - index) { body->invalid = true; return; }
  memcpy(body->data() + index, data, len);
  body->received += len;
  body->data()[body->received] = '\0';
}

// Return a job receipt, not a premature "saved" reply. Clients await the durable result.
void WeckerPresenceUsermod::enqueue(AsyncWebServerRequest* request, RequestKind kind) {
  if (kind >= RequestKind::PhoneSync && !PhoneSyncStore::supported()) { sendError(request, 501, "sync_unsupported"); return; }
  if (!authorize(request, kind)) {
    sendError(request, kind >= RequestKind::PhoneSync ? 403 : 401, kind >= RequestKind::PhoneSync ? "local_network_required" : "settings_locked"); return;
  }
  if (request->contentLength() > requestLimit(kind)) { sendError(request, 413, "request_too_large"); return; }
  const String type = request->contentType();
  if (type != F("application/json") && !type.startsWith(F("application/json;"))) { sendError(request, 415, "json_required"); return; }
  Body* body = static_cast<Body*>(request->_tempObject);
  if (!body) { sendError(request, request->contentLength() ? 503 : 400, request->contentLength() ? "low_memory" : "incomplete_body"); return; }
  if (body->invalid || body->received != body->total) { sendError(request, 400, "incomplete_body"); return; }
  uint32_t jobId;
  {
    LightAlarmGuard guard(_mutex);
    if (!guard || _queued >= QUEUE_SIZE) { sendError(request, 503, "busy"); return; }
    jobId = _nextJob++;
    if (!_nextJob) ++_nextJob;
    Job& job = _queue[_queued++];
    job.id = jobId; job.body = body; job.kind = kind;
    Result& result = _results[jobId % RESULT_COUNT];
    result = Result();
    result.id = jobId; result.revision = _publishedRevision.load(); result.code = 202; result.error = "";
    result.kind = kind;
    request->_tempObject = nullptr;
  }
  char receipt[160];
  if (kind >= RequestKind::PhoneSync) snprintf(receipt, sizeof(receipt), "{\"job\":%lu,\"confirmed\":false,\"resultUrl\":\"/wecker/sync/iphone/result?job=%lu&boot=%s\"}",
    static_cast<unsigned long>(jobId), static_cast<unsigned long>(jobId), _bootId);
  else snprintf(receipt, sizeof(receipt), "{\"job\":%lu,\"confirmed\":false,\"resultUrl\":\"/wecker/result?job=%lu\"}",
    static_cast<unsigned long>(jobId), static_cast<unsigned long>(jobId));
  request->send(202, FPSTR(CONTENT_TYPE_JSON), receipt);
}

void WeckerPresenceUsermod::sendSnapshot(AsyncWebServerRequest* request, bool status) {
  AsyncWebServerResponse* response = nullptr;
  {
    LightAlarmGuard guard(_mutex);
    if (guard) response = request->beginResponse(200, FPSTR(CONTENT_TYPE_JSON), status ? _statusSnapshot : _configSnapshot);
  }
  if (!response) { sendError(request, 503, "busy"); return; }
  response->addHeader(F("Cache-Control"), F("no-store"));
  request->send(response);
}

// A local sync-result read is restricted to sync jobs and the original boot epoch.
// No application credentials are needed; ordinary job reads keep their old policy.
void WeckerPresenceUsermod::sendResult(AsyncWebServerRequest* request, bool phone) {
  if (phone ? !localSyncRequest(request) : !unlocked()) { sendError(request, phone ? 403 : 401, phone ? "local_network_required" : "settings_locked"); return; }
  if (phone) {
    const String boot = request->arg(F("boot"));
    if (boot.length() != sizeof(_bootId) - 1 || memcmp(boot.c_str(), _bootId, sizeof(_bootId) - 1)) { sendError(request, 410, "job_from_other_boot"); return; }
  }
  const String value = request->arg(F("job"));
  if (!value.length() || value.length() > 10) { sendError(request, 400, "invalid_job"); return; }
  uint64_t parsed = 0;
  for (unsigned i = 0; i < value.length(); ++i) {
    if (value[i] < '0' || value[i] > '9') { sendError(request, 400, "invalid_job"); return; }
    parsed = parsed * 10 + value[i] - '0';
  }
  if (!parsed || parsed > UINT32_MAX) { sendError(request, 400, "invalid_job"); return; }
  Result result;
  {
    LightAlarmGuard guard(_mutex);
    if (!guard) { sendError(request, 503, "busy"); return; }
    result = _results[parsed % RESULT_COUNT];
    if (result.id == parsed && phone && result.kind < RequestKind::PhoneSync) { sendError(request, 403, "not_sync_job"); return; }
  }
  if (result.id != parsed) { sendError(request, 404, "job_expired"); return; }
  StaticJsonDocument<1024> document;
  JsonObject root = document.to<JsonObject>();
  root["job"] = result.id; root["revision"] = result.revision; root["error"] = result.error;
  root["confirmed"] = result.code == 200;
  if (result.kind >= RequestKind::PhoneSync) {
    root["version"] = SYNC_VERSION;
    root["syncRevision"] = result.syncRevision;
    root["profileRevision"] = result.profileRevision;
    root["enabled"] = result.syncEnabled;
    root["status"] = syncPhaseName(result.syncPhase);
    root["mode"] = result.syncListMode ? "list" : "single";
    root["alarmCount"] = result.syncAlarmCount;
    serializeSyncTimestamp(root, "capturedAt", result.capturedAt);
    serializeSyncTimestamp(root, "wakeAt", result.wakeAt);
  }
  char text[768];
  if (document.overflowed() || measureJson(root) >= sizeof(text)) { sendError(request, 503, "low_memory"); return; }
  serializeJson(root, text, sizeof(text));
  AsyncWebServerResponse* response = request->beginResponse(result.code, FPSTR(CONTENT_TYPE_JSON), text);
  if (!response) { sendError(request, 503, "low_memory"); return; }
  response->addHeader(F("Cache-Control"), F("no-store"));
  if (result.code == 429) response->addHeader(F("Retry-After"), F("1"));
  request->send(response);
}

// Both new views use the same credential-free local-subnet policy as sync writes.
// Neither endpoint offers a way to reset the device-owned ordering markers.
void WeckerPresenceUsermod::sendPhoneSnapshot(AsyncWebServerRequest* request, bool profile, bool alarms) {
  if (!localSyncRequest(request)) { sendError(request, 403, "local_network_required"); return; }
  AsyncWebServerResponse* response = nullptr;
  {
    LightAlarmGuard guard(_mutex);
    if (guard && (!alarms || (_phoneAlarmsPublishedRevision == _phonePublishedRevision.load() && _phoneAlarmsSnapshot.length()))) {
      response = request->beginResponse(200, FPSTR(CONTENT_TYPE_JSON), alarms ? _phoneAlarmsSnapshot : profile ? _profileSnapshot : _phoneSnapshot);
    }
  }
  if (!response) { sendError(request, 503, "busy"); return; }
  response->addHeader(F("Cache-Control"), F("no-store"));
  request->send(response);
}

void WeckerPresenceUsermod::finishJob(const Job& job, uint16_t code, const char* error) {
  LightAlarmGuard guard(_mutex);
  if (!guard) return; // The client will report an unconfirmed result, never a false success.
  Result& result = _results[job.id % RESULT_COUNT];
  result.code = code; result.error = error; result.revision = _config.revision;
  result.syncRevision = _phone.revision; result.profileRevision = _phone.profileRevision;
  result.capturedAt = _phone.capturedAt; result.wakeAt = _phone.wakeAt; result.syncPhase = _phone.phase;
  result.syncEnabled = _phone.enabled && _config.enabled;
  result.syncListMode = _phone.listMode;
  result.syncAlarmCount = _phone.alarmCount;
}

// Serve no more than 24 entries per request. The full 96-entry RAM history is
// deliberately absent from the one-second status publisher and its shared JSON buffer.
void WeckerPresenceUsermod::sendProbeLog(AsyncWebServerRequest* request) {
  constexpr uint8_t MAX_PAGE = 24;
  uint8_t offset = 0, limit = MAX_PAGE;
  if ((request->hasArg(F("offset")) && !logQueryNumber(request->arg(F("offset")), PresenceProvider::logCapacity(), offset)) ||
      (request->hasArg(F("limit")) && (!logQueryNumber(request->arg(F("limit")), MAX_PAGE, limit) || !limit))) {
    sendError(request, 400, "invalid_log_page"); return;
  }
  PresenceProvider::RoundLog page[MAX_PAGE];
  uint8_t count, total;
  uint32_t generation;
  if (!_presence.copyLog(offset, limit, page, count, total, generation)) { sendError(request, 503, "busy"); return; }
  if (getFreeHeapSize() < MIN_HEAP_SIZE + 8192) { sendError(request, 503, "low_memory"); return; }
  AsyncJsonResponse* response = new (std::nothrow) AsyncJsonResponse(5120);
  if (!response) { sendError(request, 503, "low_memory"); return; }
  JsonObject root = response->getRoot();
  if (root.isNull()) { delete response; sendError(request, 503, "low_memory"); return; }
  root["capacity"] = PresenceProvider::logCapacity();
  root["total"] = total;
  root["generation"] = generation;
  root["offset"] = offset;
  if (unsigned(offset) + count < total) root["nextOffset"] = offset + count;
  else root["nextOffset"] = nullptr;
  JsonArray entries = root.createNestedArray("entries");
  for (uint8_t i = 0; i < count; ++i) {
    JsonObject entry = entries.createNestedObject();
    serializeProbeLog(entry, page[i]);
    if (entry.size() != 8) { delete response; sendError(request, 503, "low_memory"); return; }
  }
  response->addHeader(F("Cache-Control"), F("no-store"));
  response->setLength();
  request->send(response);
}

bool WeckerPresenceUsermod::commitCandidate(const char*& error) {
  _candidate.revision = _config.revision + 1;
  if (!_candidate.revision) _candidate.revision = 1;
  _lastSaveAttempt = millis();
  if (!_store.save(_candidate, error)) { _storageError = error; return false; }
  bool stopCurrent = false;
  if (_runner.active() && _runningOccurrence.index != PHONE_ALARM_INDEX) {
    bool found = false, oldEnabled = false;
    for (uint8_t i = 0; i < _config.count; ++i) {
      if (!strcmp(_config.alarms[i].id, _runner.alarm().id)) oldEnabled = _config.alarms[i].enabled;
    }
    for (uint8_t i = 0; i < _candidate.count; ++i) {
      if (strcmp(_candidate.alarms[i].id, _runner.alarm().id)) continue;
      found = true;
      stopCurrent = oldEnabled && !_candidate.alarms[i].enabled;
      break;
    }
    stopCurrent |= !found;
  }
  const bool targetChanged = strcmp(_candidate.presenceHost, _config.presenceHost);
  _config = _candidate;
  _publishedRevision = _config.revision;
  _configurationValid = true;
  _storageError = "";
  if (targetChanged) _presence.configure(_config.presenceHost);
  if (!_config.enabled && _runner.active()) stopRunner("disabled");
  else if (stopCurrent) stopRunner("alarm_disabled_or_removed");
  publishConfiguration();
  _lastSchedule = UINT32_MAX;
  return true;
}

// Corruption is isolated from manual alarms. Rewrite the former credential schema
// without its obsolete fields, and never resume a previously started occurrence.
void WeckerPresenceUsermod::loadPhoneConfiguration() {
  if (!PhoneSyncStore::supported()) { _phoneLoaded = true; return; }
  // A transient JSON-lock/heap shortage must not reread a large NVS blob every loop.
  if (_phoneLoadAttempted && millis() - _phoneLastLoadAttempt < 5000) return;
  _phoneLoadAttempted = true;
  _phoneLastLoadAttempt = millis();
  _phoneCandidate.reset();
  const char* error = "";
  bool migration = false;
  if (!_phoneStore.load(_phoneCandidate, migration, error)) {
    _phoneStorageError = error;
    _phoneLoaded = strcmp(error, "busy") != 0 && strcmp(error, "low_memory") != 0;
    return;
  }
  _phone = _phoneCandidate;
  _phonePublishedRevision = _phone.revision;
  _phoneLoaded = _phoneValid = true;
  _phoneStorageError = "";
  if (migration || _phone.phase == SyncPhase::Started) {
    if (_phone.phase == SyncPhase::Started) _phoneCandidate.phase = SyncPhase::Interrupted;
    _phoneCandidate.revision = advanceRevision(_phone.revision);
    if (!commitPhoneCandidate(error)) _phoneStorageError = error;
  }
}

// Persist first, then apply the independently owned slot. A clear/profile disable
// never interrupts a running manual alarm or changes its persistent configuration.
bool WeckerPresenceUsermod::commitPhoneCandidate(const char*& error, const char* reason) {
  _phoneLastSaveAttempt = millis();
  if (!_phoneStore.save(_phoneCandidate, error)) { _phoneStorageError = error; return false; }
  bool cancel = false;
  if (_runner.active() && !_runner.preview() && _runningOccurrence.index == PHONE_ALARM_INDEX) {
    cancel = !_phoneCandidate.enabled;
    if (_runningOccurrence.phoneIndex != UINT8_MAX) {
      cancel |= !phoneListRetainsOccurrence(_phoneCandidate, _runningPhoneAlarm, _runningOccurrence.date);
    } else {
      cancel |= _phoneCandidate.listMode || _phoneCandidate.wakeAt.seconds != _runningOccurrence.wake ||
        _phoneCandidate.phase == SyncPhase::Empty || _phoneCandidate.phase == SyncPhase::Cancelled;
    }
  }
  _phone = _phoneCandidate;
  _phonePublishedRevision = _phone.revision;
  _phoneStorageError = "";
  if (cancel) stopRunner(reason);
  _lastSchedule = UINT32_MAX;
  return true;
}

// Called with the JSON lock held; every path releases it before NVS or LED access.
// Only client writes are rate-limited; durable start/stop markers are never delayed.
uint16_t WeckerPresenceUsermod::processPhoneJob(const Job& job, JsonVariantConst root, const char*& error) {
  SyncDecision decision;
  if (!_phoneValid) { decision.code = 503; decision.error = "sync_configuration_unavailable"; }
  else if (job.kind == RequestKind::PhoneSync) {
    PhoneSyncMessage message;
    if (!parseSyncMessage(root.as<JsonObjectConst>(), message, decision.error)) decision.code = 422;
    else decision = stagePhoneSync(_phone, message, toki.second(), clockValid(), _phoneCandidate);
  } else if (job.kind == RequestKind::PhoneAlarms) {
    decision = stagePhoneAlarmList(root, _phone, toki.second(), clockValid(), WLED_CLOCK, _phoneCandidate);
  } else {
    decision = stagePhoneProfile(root.as<JsonObjectConst>(), _config, _phone, _phoneCandidate);
  }
  pDoc->clear();
  releaseJSONBufferLock();
  error = decision.error;
  if (decision.code != 200 || !decision.changed) return decision.code;
  if (_phoneRequestWritten && millis() - _phoneLastRequestWrite < 1000) { error = "sync_rate_limited"; return 429; }
  if (!commitPhoneCandidate(error, _phoneCandidate.wakeAt.seconds ? "iphone_sync_changed" : "iphone_sync_cleared")) return 500;
  _phoneLastRequestWrite = millis();
  _phoneRequestWritten = true;
  return 200;
}

// Outcome writes are useful diagnostics, but failure cannot undo the required
// pre-start consumption marker. Never apply an old runner's outcome to a new slot.
void WeckerPresenceUsermod::setPhoneOutcome(SyncPhase phase, uint32_t wake) {
  if (!_phoneValid || !wake || _phone.wakeAt.seconds != wake || _phone.phase == phase ||
      _phone.phase == SyncPhase::Empty || _phone.phase == SyncPhase::Cancelled || _phone.consumedThrough < wake) return;
  _phoneCandidate = _phone;
  _phoneCandidate.phase = phase;
  _phoneCandidate.revision = advanceRevision(_phone.revision);
  const char* error = "";
  commitPhoneCandidate(error);
}

const Alarm& WeckerPresenceUsermod::occurrenceAlarm(const Occurrence& occurrence) const {
  return occurrence.index == PHONE_ALARM_INDEX ? _phone.profile : _config.alarms[occurrence.index];
}

// The visual profile is shared, but status and the running curve show Clock's label.
const char* WeckerPresenceUsermod::occurrenceLabel(const Occurrence& occurrence) const {
  return occurrence.index == PHONE_ALARM_INDEX && occurrence.phoneIndex < _phone.alarmCount ?
    _phone.alarms[occurrence.phoneIndex].label : occurrenceAlarm(occurrence).label;
}

// Keep the source identity in the index sentinel, not an ID string: even a manual
// alarm named 'iphone' remains manually owned and cannot be deleted by a sync.
Occurrence WeckerPresenceUsermod::nextScheduled(uint32_t now, bool dueOnly, bool manualAllowed, bool phoneAllowed) const {
  return nextCombinedOccurrence(_config, _phone, now, WLED_CLOCK, dueOnly, manualAllowed, phoneAllowed && _phoneValid);
}

// Validate the complete update before replacing anything. Execution dates are
// device-owned, so editing a stale browser copy cannot replay yesterday's alarm.
void WeckerPresenceUsermod::processJob() {
  if (!_queued.load() || !requestJSONBufferLock(JSON_LOCK_LIGHT_ALARM)) return;
  Job job;
  {
    LightAlarmGuard guard(_mutex);
    if (!guard || !_queued) { releaseJSONBufferLock(); return; }
    job = _queue[0];
    for (uint8_t i = 1; i < _queued; ++i) _queue[i - 1] = _queue[i];
    --_queued;
  }
  const char* error = "";
  uint16_t code = 200;
  const bool validEnvelope = job.kind < RequestKind::PhoneSync || validSyncJsonEnvelope(job.body->data(), job.body->total, job.kind == RequestKind::PhoneAlarms);
  const DeserializationError parseError = deserializeJson(*pDoc, job.body->data(), job.body->total,
    DeserializationOption::NestingLimit(8));
  if (!validEnvelope || parseError || (!pDoc->is<JsonObject>() && !(job.kind == RequestKind::PhoneAlarms && pDoc->is<JsonArray>()))) { code = 400; error = "invalid_json"; }
  else if (job.kind >= RequestKind::PhoneSync) {
    code = processPhoneJob(job, pDoc->as<JsonVariantConst>(), error); // Releases the document before NVS/LED access.
    p_free(job.body);
    publishStatus();
    finishJob(job, code, error);
    return;
  }
  else if (job.kind == RequestKind::Control) {
    // Control can use the locked document, but must release it before any FS access.
    JsonObjectConst root = pDoc->as<JsonObjectConst>();
    char action[24] = "", id[33] = "";
    strlcpy(action, root["action"] | "", sizeof(action));
    strlcpy(id, root["id"] | "", sizeof(id));
    const bool invalid = strnlen(root["action"] | "", 25) >= sizeof(action) || strnlen(root["id"] | "", 34) >= sizeof(id);
    releaseJSONBufferLock();
    if (invalid) { code = 422; error = "invalid_control"; }
    else {
      StaticJsonDocument<160> command;
      command["action"] = action; command["id"] = id;
      code = control(command.as<JsonObjectConst>(), error);
    }
    p_free(job.body);
    publishStatus();
    finishJob(job, code, error);
    return;
  } else if (_legacy) { code = 409; error = "migration_waiting_for_time"; }
  else {
    JsonVariantConst root = pDoc->as<JsonVariantConst>();
    if (!root["revision"].is<uint32_t>() || root["revision"].as<uint32_t>() != _config.revision) { code = 409; error = "revision_conflict"; }
    else if (!parseConfig(root, _candidate, false, error)) code = 422;
    else {
      for (uint8_t i = 0; i < _candidate.count; ++i) {
        Alarm& alarm = _candidate.alarms[i];
        alarm.lastDate = alarm.skipDate = 0;
        for (uint8_t j = 0; j < _config.count; ++j) {
          if (strcmp(alarm.id, _config.alarms[j].id)) continue;
          alarm.lastDate = _config.alarms[j].lastDate;
          alarm.skipDate = _config.alarms[j].skipDate;
          // Explicitly re-arming an expired one-shot schedules its newly chosen date.
          if (!alarm.weekdays && alarm.date != _config.alarms[j].date && alarm.date > alarm.lastDate) alarm.skipDate = 0;
          break;
        }
        if (alarm.enabled && !alarm.weekdays && alarm.date <= alarm.lastDate) { code = 422; error = "one_off_already_used"; break; }
        if (alarm.enabled && !alarm.weekdays && clockValid()) {
          const uint32_t wake = resolveLocal(dateEpoch(alarm.date) + alarm.wakeMinute * 60U, WLED_CLOCK);
          if (wake + LATE_START_SECONDS < toki.second()) { code = 422; error = "one_off_in_past"; break; }
        }
      }
    }
  }
  releaseJSONBufferLock();
  if (code == 200 && !commitCandidate(error)) code = 500;
  p_free(job.body);
  publishStatus();
  finishJob(job, code, error);
}

uint16_t WeckerPresenceUsermod::control(JsonObjectConst command, const char*& error) {
  const char* action = command["action"] | "";
  if (!strcmp(action, "presence-check")) { _presence.request(); return 200; }
  if (!strcmp(action, "stop")) { stopRunner("stopped"); return 200; }
  if (!strcmp(action, "snooze")) {
    if (_presence.state(millis()) != Presence::Present || !_runner.snooze(millis())) { error = "snooze_unavailable"; return 409; }
    _frame = _runner.frame(millis());
    _lights.render(_runner.alarm(), _frame, _fallback);
    return 200;
  }
  if (!strcmp(action, "preview")) {
    if (_runner.active()) { error = "alarm_already_running"; return 409; }
    const char* id = command["id"] | "";
    for (uint8_t i = 0; i < _config.count; ++i) {
      if (strcmp(id, _config.alarms[i].id)) continue;
      if (!_lights.begin(_config.alarms[i], true, _fallback, error)) return 409;
      _runner.start(_config.alarms[i], millis(), 0, true);
      _runningOccurrence = Occurrence();
      _finishReason = "preview_completed";
      return 200;
    }
    error = "alarm_not_found"; return 404;
  }
  if (!strcmp(action, "skip")) {
    if (!clockValid()) { error = "time_not_set"; return 409; }
    Occurrence next = nextScheduled(toki.second());
    if (!next) { error = "no_next_alarm"; return 409; }
    if (next.index == PHONE_ALARM_INDEX) {
      if (!stagePhoneConsumption(_phone, next, _phoneCandidate, SyncPhase::Skipped)) { error = "no_next_alarm"; return 409; }
      if (!commitPhoneCandidate(error)) return 500;
      recordEvent(_phone.profile.id, "skipped_manually", next.date, true);
      return 200;
    }
    _candidate = _config;
    _candidate.alarms[next.index].skipDate = next.date;
    if (!commitCandidate(error)) return 500;
    recordEvent(_config.alarms[next.index].id, "skipped_manually", next.date);
    return 200;
  }
  error = "unknown_action";
  return 422;
}

void WeckerPresenceUsermod::migrateLegacy() {
  if (!_legacy || !clockValid() || millis() - _migrationRetry < 5000) return;
  _migrationRetry = millis();
  _candidate = _config;
  const uint32_t now = toki.second(), today = epochDate(wledUtcToLocal(now));
  for (uint8_t i = 0; i < _candidate.count; ++i) {
    Alarm& alarm = _candidate.alarms[i];
    if (alarm.weekdays) continue;
    alarm.date = today;
    const uint32_t wake = resolveLocal(dateEpoch(today) + alarm.wakeMinute * 60U, WLED_CLOCK);
    if (wake <= now) alarm.date = epochDate(dateEpoch(today) + SECONDS_PER_DAY);
  }
  const char* error = "";
  if (!_store.preserveLegacy(error) || !commitCandidate(error)) { _storageError = error; return; }
  _legacy = false;
  publishConfiguration();
  recordEvent("", "legacy_migrated", today);
}

void WeckerPresenceUsermod::recordEvent(const char* id, const char* reason, uint32_t date, bool phone) {
  Event& event = _events[_eventHead];
  _eventHead = (_eventHead + 1) % EVENT_COUNT;
  event.time = toki.second(); event.date = date; event.reason = reason;
  event.phone = phone;
  strlcpy(event.id, id, sizeof(event.id));
}

// Share event rendering while preserving which storage/source owns the occurrence.
void WeckerPresenceUsermod::recordOccurrence(const Occurrence& occurrence, const char* reason, SyncPhase phase) {
  const bool phone = occurrence.index == PHONE_ALARM_INDEX;
  recordEvent(occurrenceAlarm(occurrence).id, reason, occurrence.date, phone);
  if (phone) setPhoneOutcome(phase, occurrence.wake);
}

// Mark each occurrence durably before taking control of the LEDs. Overlaps and
// suppressed occurrences are consumed individually without disabling recurring alarms.
void WeckerPresenceUsermod::schedule(uint32_t now) {
  if (!_configurationValid || !_config.enabled || _legacy || !clockValid()) return;
  // Keep a failed update's previous schedule in service, but do not hammer a full
  // filesystem when execution markers cannot be written. Starting still requires a successful write.
  bool manualAllowed = !_storageError[0] || millis() - _lastSaveAttempt >= 5000;
  bool phoneAllowed = !_phoneStorageError[0] || millis() - _phoneLastSaveAttempt >= 5000;
  for (uint8_t scanned = 0; scanned <= MAX_ALARMS + MAX_PHONE_ALARMS; ++scanned) {
    Occurrence due = nextScheduled(now, true, manualAllowed, phoneAllowed);
    if (!due) return;
    if (waitForPresence(due, now, _presence.state(millis()), _config.presenceHost[0], _presence.firstCheckPending())) {
      if (_presenceWaitWake != due.wake || _presenceWaitIndex != due.index || strcmp(_presenceWaitId, occurrenceAlarm(due).id)) {
        _presenceWaitWake = due.wake;
        _presenceWaitIndex = due.index;
        strlcpy(_presenceWaitId, occurrenceAlarm(due).id, sizeof(_presenceWaitId));
        _presence.request(false); // One targeted retry, never a 15-second polling loop.
      }
      return;
    }
    if (_runner.active() && _runner.preview()) stopRunner("preview_interrupted_by_alarm");
    const char* error = "";
    if (due.index == PHONE_ALARM_INDEX) {
      if (!stagePhoneConsumption(_phone, due, _phoneCandidate) || !commitPhoneCandidate(error)) { phoneAllowed = false; continue; }
    } else {
      _candidate = _config;
      _candidate.alarms[due.index].lastDate = due.date;
      if (!_candidate.alarms[due.index].weekdays) _candidate.alarms[due.index].enabled = false;
      if (!commitCandidate(error)) { manualAllowed = false; continue; }
    }
    Alarm alarm = occurrenceAlarm(due);
    if (due.index == PHONE_ALARM_INDEX && due.phoneIndex < _phone.alarmCount) {
      strlcpy(alarm.label, _phone.alarms[due.phoneIndex].label, sizeof(alarm.label));
    }
    const Presence presence = _presence.state(millis());
    if (_runner.active()) { recordOccurrence(due, "overlapping_alarm", SyncPhase::Skipped); continue; }
    if (presence != Presence::Present) { recordOccurrence(due, presence == Presence::Absent ? "phone_unreachable" : "presence_unknown", SyncPhase::Skipped); continue; }
    if (!_lights.begin(alarm, false, _fallback, error)) { recordOccurrence(due, error, SyncPhase::Skipped); continue; }
    _runner.start(alarm, millis(), (now - due.start) * 1000U);
    _runningOccurrence = due;
    if (due.phoneIndex < _phone.alarmCount) _runningPhoneAlarm = _phone.alarms[due.phoneIndex];
    _finishReason = "completed";
    recordOccurrence(due, _fallback ? "started_with_fallback" : "started", SyncPhase::Started);
  }
}

void WeckerPresenceUsermod::stopRunner(const char* reason, bool manual) {
  if (!_runner.active()) return;
  const bool preview = _runner.preview();
  const bool phone = _runningOccurrence.index == PHONE_ALARM_INDEX;
  recordEvent(_runner.alarm().id, reason, _runningOccurrence.date, phone);
  _runner.stop();
  _lights.release(preview && !manual, !manual);
  _frame = Frame();
  if (phone && !preview) setPhoneOutcome(SyncPhase::Stopped, _runningOccurrence.wake);
}

void WeckerPresenceUsermod::serviceRunner(uint32_t nowMs) {
  if (!_runner.active()) return;
  if (_lights.interrupted()) { stopRunner("manual_override", true); return; }
  if (!_runner.preview() && _presence.state(nowMs) != Presence::Present) {
    _finishReason = _presence.state(nowMs) == Presence::Absent ? "phone_unreachable" : "presence_expired";
    _runner.fadeOut(nowMs, _frame);
  }
  if (nowMs - _lastRender < 100) return;
  _lastRender = nowMs;
  _frame = _runner.frame(nowMs);
  if (!_lights.render(_runner.alarm(), _frame, _fallback)) {
    recordEvent(_runner.alarm().id, "led_configuration_changed", _runningOccurrence.date, _runningOccurrence.index == PHONE_ALARM_INDEX);
    _runner.stop();
    _lights.release(false, false);
    _frame = Frame();
    if (!_runner.preview() && _runningOccurrence.index == PHONE_ALARM_INDEX) setPhoneOutcome(SyncPhase::Stopped, _runningOccurrence.wake);
    return;
  }
  if (!_runner.active()) {
    _lights.release(_runner.preview(), !_runner.preview());
    recordEvent(_runner.alarm().id, _finishReason, _runningOccurrence.date, _runningOccurrence.index == PHONE_ALARM_INDEX);
    _frame = Frame();
    if (!_runner.preview() && _runningOccurrence.index == PHONE_ALARM_INDEX) setPhoneOutcome(!strcmp(_finishReason, "completed") ? SyncPhase::Completed : SyncPhase::Stopped, _runningOccurrence.wake);
  }
}

void WeckerPresenceUsermod::publishConfiguration() {
  _configurationDirty = true;
  if (!requestJSONBufferLock(JSON_LOCK_LIGHT_ALARM)) return;
  JsonObject root = pDoc->to<JsonObject>();
  serializeConfig(root, _config);
  root["migrationPending"] = _legacy;
  String snapshot;
  const bool reserved = snapshot.reserve(measureJson(root) + 1);
  if (reserved && !pDoc->overflowed()) serializeJson(root, snapshot);
  releaseJSONBufferLock();
  if (!snapshot.length()) { _storageError = "low_memory"; return; }
  LightAlarmGuard guard(_mutex);
  if (guard) { _configSnapshot = std::move(snapshot); _configurationDirty = false; }
}

// Separate public serialization from private NVS encoding. UTC ISO values are
// portable between phones; Local values are only for WLED's existing status UI.
void WeckerPresenceUsermod::serializePhoneStatus(JsonObject root, uint32_t now) const {
  const bool running = _runner.active() && !_runner.preview() && _runningOccurrence.index == PHONE_ALARM_INDEX;
  const Occurrence listNext = _phone.listMode && clockValid() ? nextPhoneListOccurrence(_phone, now, WLED_CLOCK) : Occurrence();
  const uint32_t wake = running ? _runningOccurrence.wake : _phone.listMode ? listNext.wake : _phone.wakeAt.seconds;
  const uint32_t start = running ? _runningOccurrence.start : wake ? wake - _phone.profile.rampMinutes * 60U : 0;
  const uint32_t end = running ? _runningOccurrence.end : wake ? wake + (_phone.profile.holdMinutes + _phone.profile.fadeMinutes) * 60U : 0;
  const char* state = syncPhaseName(_phone.phase);
  if (!PhoneSyncStore::supported()) state = "unsupported";
  else if (!_phoneValid) state = "unavailable";
  else if (!_phone.enabled || !_config.enabled) state = "disabled";
  else if (running) state = "started";
  else if (_phone.listMode && !clockValid() && _phone.alarmCount) state = "waiting_for_time";
  else if (_phone.listMode && listNext) state = "scheduled";
  else if (_phone.listMode && !_phone.alarmCount) state = "empty";
  else if (_phone.phase == SyncPhase::Started) state = "interrupted";
  else if (_phone.phase == SyncPhase::Scheduled && !clockValid()) state = "waiting_for_time";
  else if (_phone.phase == SyncPhase::Scheduled && (now > wake + LATE_START_SECONDS || now >= end)) state = "expired";
  root["version"] = SYNC_VERSION;
  root["source"] = "iphone";
  root["mode"] = _phone.listMode ? "list" : "single";
  root["alarmCount"] = _phone.alarmCount;
  root["maxAlarms"] = MAX_PHONE_ALARMS;
  root["supported"] = PhoneSyncStore::supported();
  root["access"] = "local_ipv4";
  root["configurationValid"] = _phoneValid;
  root["enabled"] = _phone.enabled;
  root["masterEnabled"] = _config.enabled;
  root["clockValid"] = clockValid();
  root["revision"] = _phone.revision;
  root["profileRevision"] = _phone.profileRevision;
  root["status"] = state;
  root["occurrenceState"] = syncPhaseName(_phone.phase);
  root["storageError"] = _phoneStorageError;
  root["label"] = running ? _runner.alarm().label : listNext ? occurrenceLabel(listNext) : _phone.profile.label;
  serializeSyncTimestamp(root, "capturedAt", _phone.capturedAt);
  serializeSyncTimestamp(root, "wakeAt", SyncTimestamp(wake));
  serializeSyncTimestamp(root, "startAt", SyncTimestamp(start));
  serializeSyncTimestamp(root, "endAt", SyncTimestamp(end));
  serializeSyncTimestamp(root, "consumedThrough", SyncTimestamp(_phone.consumedThrough));
  serializeSyncTimestamp(root, "deviceAt", SyncTimestamp(clockValid() ? now : 0));
  if (_phone.capturedAt.seconds) root["capturedLocal"] = wledUtcToLocal(_phone.capturedAt.seconds);
  if (wake) {
    root["wakeLocal"] = wledUtcToLocal(wake);
    root["startLocal"] = wledUtcToLocal(start);
    root["endLocal"] = wledUtcToLocal(end);
  }
}

void WeckerPresenceUsermod::publishStatus() {
  if (!requestJSONBufferLock(JSON_LOCK_LIGHT_ALARM)) return;
  JsonObject root = pDoc->to<JsonObject>();
  const uint32_t now = toki.second(), nowMs = millis();
  root["version"] = SCHEMA_VERSION;
  root["revision"] = _config.revision;
  root["enabled"] = _config.enabled;
  root["clockValid"] = clockValid();
  root["clockSource"] = toki.getTimeSource();
  root["deviceLocal"] = wledUtcToLocal(now);
  root["connected"] = bool(WLED_CONNECTED);
  root["storageError"] = _storageError;
  root["configurationValid"] = _configurationValid;
  root["migrationPending"] = _legacy;
  serializePhoneStatus(root.createNestedObject("iphone"), now);
  JsonObject presence = root.createNestedObject("presence");
  presence["policyVersion"] = 2;
  presence["probeVersion"] = 3;
  presence["state"] = presenceName(_presence.state(nowMs));
  presence["checking"] = _presence.busy();
  presence["error"] = _presence.error();
  if (_presence.age(nowMs) == UINT32_MAX) presence["ageSeconds"] = nullptr;
  else presence["ageSeconds"] = _presence.age(nowMs) / 1000;
  if (_presence.confirmationAge(nowMs) == UINT32_MAX) presence["confirmationAgeSeconds"] = nullptr;
  else presence["confirmationAgeSeconds"] = _presence.confirmationAge(nowMs) / 1000;
  presence["confirmationRemainingSeconds"] = _presence.confirmationRemaining(nowMs) / 1000;
  presence["graceActive"] = _presence.grace(nowMs);
  presence["monitoring"] = monitoringName(_presencePolicy.mode);
  presence["intervalSeconds"] = _presencePolicy.intervalMs / 1000;
  if (_presence.nextCheck(nowMs) == UINT32_MAX) presence["nextCheckSeconds"] = nullptr;
  else presence["nextCheckSeconds"] = _presence.nextCheck(nowMs) / 1000;
  presence["probeRounds"] = _presence.rounds();
  presence["historyCapacity"] = PresenceProvider::logCapacity();
  presence["historyRamBytes"] = PresenceProvider::logRamBytes();
  presence["historyStored"] = _presence.logSize();
  presence["historyGeneration"] = _presence.logGeneration();
  presence["historyDropped"] = _presence.droppedLogs();
  presence["udpAttempts"] = _presence.attempts();
  presence["udpProbeSent"] = _presence.udpSent();
  presence["ping"] = bool(_presence.methods() & Probe::PING);
  presence["tcp"] = bool(_presence.methods() & Probe::TCP);
  presence["mdns"] = bool(_presence.methods() & Probe::MDNS);
  presence["icmp"] = bool(_presence.methods() & Probe::ICMP);
  presence["arp"] = _presence.arpStatus();
  JsonArray checks = presence.createNestedArray("history");
  for (uint8_t age = 0; age < min(uint8_t(12), _presence.logSize()); ++age) {
    const auto& entry = _presence.log(age);
    serializeProbeLog(checks.createNestedObject(), entry);
  }
  JsonObject run = root.createNestedObject("run");
  run["active"] = _runner.active();
  run["preview"] = _runner.preview();
  run["phase"] = phaseName(_frame.phase);
  run["progress"] = _frame.progress;
  if (_runner.active()) { run["id"] = _runner.alarm().id; run["label"] = _runner.alarm().label; run["source"] = _runningOccurrence.index == PHONE_ALARM_INDEX ? "iphone" : "manual"; }
  if (clockValid() && !_legacy) {
    Occurrence next = nextScheduled(now);
    if (next) {
      JsonObject item = root.createNestedObject("next");
      item["id"] = occurrenceAlarm(next).id;
      item["label"] = occurrenceLabel(next);
      item["source"] = next.index == PHONE_ALARM_INDEX ? "iphone" : "manual";
      item["date"] = next.date;
      item["startLocal"] = wledUtcToLocal(next.start);
      item["wakeLocal"] = wledUtcToLocal(next.wake);
      item["endLocal"] = wledUtcToLocal(next.end);
    }
  }
  JsonArray events = root.createNestedArray("events");
  for (uint8_t age = 0; age < EVENT_COUNT; ++age) {
    const Event& event = _events[(_eventHead + EVENT_COUNT - 1 - age) % EVENT_COUNT];
    if (!event.time) continue;
    JsonObject item = events.createNestedObject();
    item["id"] = event.id; item["timeLocal"] = wledUtcToLocal(event.time);
    item["date"] = event.date; item["reason"] = event.reason;
    item["source"] = event.phone ? "iphone" : "manual";
  }
  // Double-buffer published status: retain both string capacities between ticks.
  // Only HTTP response ownership requires a copy; the normal loop does not churn heap.
  _statusBuild = "";
  if (_statusBuild.reserve(measureJson(root) + 1) && !pDoc->overflowed()) serializeJson(root, _statusBuild);
  JsonObject phone = pDoc->to<JsonObject>();
  serializePhoneStatus(phone, now);
  _phoneBuild = "";
  if (_phoneBuild.reserve(measureJson(phone) + 1) && !pDoc->overflowed()) serializeJson(phone, _phoneBuild);
  JsonObject profile = pDoc->to<JsonObject>();
  profile["version"] = SYNC_VERSION;
  profile["supported"] = PhoneSyncStore::supported();
  profile["revision"] = _phone.profileRevision;
  profile["enabled"] = _phone.enabled;
  serializeLightProfile(profile.createNestedObject("profile"), _phone.profile);
  _profileBuild = "";
  if (_profileBuild.reserve(measureJson(profile) + 1) && !pDoc->overflowed()) serializeJson(profile, _profileBuild);
  // Publish the full imported list only on changes, never in the one-second status
  // payload. A revision mismatch makes a read report busy rather than stale data.
  String alarmsSnapshot;
  const bool refreshAlarms = !_phoneAlarmsSnapshot.length() || _phoneAlarmsPublishedRevision != _phone.revision;
  if (refreshAlarms) {
    JsonObject list = pDoc->to<JsonObject>();
    list["version"] = SYNC_VERSION;
    list["supported"] = PhoneSyncStore::supported();
    list["revision"] = _phone.revision;
    list["mode"] = _phone.listMode ? "list" : "single";
    list["maxAlarms"] = MAX_PHONE_ALARMS;
    serializeSyncTimestamp(list, "capturedAt", _phone.capturedAt);
    JsonArray alarms = list.createNestedArray("alarms");
    for (uint8_t i = 0; i < _phone.alarmCount; ++i) serializePhoneAlarm(alarms.createNestedObject(), _phone.alarms[i]);
    if (alarmsSnapshot.reserve(measureJson(list) + 1) && !pDoc->overflowed()) serializeJson(list, alarmsSnapshot);
  }
  releaseJSONBufferLock();
  if (!_statusBuild.length()) return;
  LightAlarmGuard guard(_mutex);
  if (guard) {
    std::swap(_statusSnapshot, _statusBuild);
    if (_phoneBuild.length()) std::swap(_phoneSnapshot, _phoneBuild);
    if (_profileBuild.length()) std::swap(_profileSnapshot, _profileBuild);
    if (refreshAlarms && alarmsSnapshot.length()) {
      _phoneAlarmsSnapshot = std::move(alarmsSnapshot);
      _phoneAlarmsPublishedRevision = _phone.revision;
    }
  }
}

void WeckerPresenceUsermod::loop() {
  if (!_ready || _firmwareUpdating.load()) return;
  if (!_loaded) loadConfiguration();
  if (!_phoneLoaded) loadPhoneConfiguration();
  processJob();
  if (_configurationDirty) publishConfiguration();
  migrateLegacy();
  const uint32_t now = toki.second();
  if (now != _lastSchedule) {
    const bool valid = clockValid() && !_legacy && _configurationValid;
    const Occurrence next = valid ? nextScheduled(now) : Occurrence();
    _presencePolicy = presencePolicy(_config.enabled, valid, next, _runner.active() && !_runner.preview(), now);
    _presence.setInterval(_presencePolicy.intervalMs);
  }
  _presence.service(millis());
  serviceRunner(millis());
  if (now != _lastSchedule) {
    // A large correction must re-evaluate scheduling; the active monotonic runner
    // and persisted per-date execution markers are deliberately left untouched.
    if (_presencePolicy.intervalMs && _lastClock && (now > _lastClock + 60 || now + 60 < _lastClock)) _presence.request(false);
    _lastClock = now;
    _lastSchedule = now;
    schedule(now);
  }
  if (millis() - _lastPublish >= 1000) { _lastPublish = millis(); publishStatus(); }
}

void WeckerPresenceUsermod::onStateChange(uint8_t) {
  if (_ready) _lights.stateChangedExternally();
}

void WeckerPresenceUsermod::onUpdateBegin(bool active) {
  _firmwareUpdating = active;
  _presence.firmwareUpdate(active);
}

// Legacy usermod settings are read once for migration; the new UI edits wecker.json.
bool WeckerPresenceUsermod::readFromConfig(JsonObject& root) {
  if (_ready) return true;
  JsonObject old = root[FPSTR(_name)];
  if (!old.isNull()) {
    _legacyEnabled = old["enabled"] | true;
    const char* host = old["presenceAddr"] | (old["hostname"] | "");
    if (host[0] && validHost(host)) strlcpy(_legacyHost, host, sizeof(_legacyHost));
  }
  return true;
}

void WeckerPresenceUsermod::addToConfig(JsonObject&) {
  // Do not mirror alarm settings into cfg.json or commandeer the regular WLED timers.
}

void WeckerPresenceUsermod::addToJsonInfo(JsonObject& root) {
  root["lightalarm"] = SCHEMA_VERSION; // Main navigation only advertises a linked backend.
  if (PhoneSyncStore::supported()) root["lightalarmSync"] = SYNC_VERSION;
}
// AI: end
#endif // WLED_DISABLE_WECKER
