#pragma once

#include "light_alarm_config.h"

// AI: below section was generated by an AI
namespace LightAlarm {

constexpr uint8_t SYNC_VERSION = 2;
constexpr uint8_t PHONE_ALARM_INDEX = MAX_ALARMS; // Not an index into Config::alarms.
constexpr uint32_t SYNC_MAX_CAPTURE_AGE = SECONDS_PER_DAY;
constexpr uint32_t SYNC_FUTURE_SKEW = 300;
constexpr uint32_t SYNC_MAX_LOOKAHEAD = 8U * SECONDS_PER_DAY;

struct SyncTimestamp {
  uint32_t seconds = 0;
  uint16_t milliseconds = 0;
  SyncTimestamp() = default;
  explicit SyncTimestamp(uint32_t sec, uint16_t fraction = 0) : seconds(sec), milliseconds(fraction) {}
  uint64_t value() const { return uint64_t(seconds) * 1000 + milliseconds; }
  bool operator==(const SyncTimestamp& other) const { return value() == other.value(); }
};

enum class SyncPhase : uint8_t { Empty, Scheduled, Consumed, Started, Completed, Skipped, Stopped, Cancelled, Interrupted };

struct PhoneSyncRecord {
  uint32_t revision = 0, profileRevision = 0, consumedThrough = 0;
  SyncTimestamp capturedAt, wakeAt;
  SyncPhase phase = SyncPhase::Empty;
  bool enabled = false; // Installation alone never arms the phone slot.
  Alarm profile;
  PhoneSyncRecord() {
    strcpy(profile.id, "iphone");
    strcpy(profile.label, "iPhone");
    profile.weekdays = 0;
  }
};

struct PhoneSyncMessage { SyncTimestamp capturedAt, wakeAt; };
struct SyncDecision { uint16_t code = 200; const char* error = ""; bool changed = false; };

inline uint32_t advanceRevision(uint32_t revision) { return revision == UINT32_MAX ? 1 : revision + 1; }

// ArduinoJson 6.18 stores decoded strings without their original lengths. Reject
// NULs/NUL escapes before decoding, and require exactly one complete JSON object
// so a valid clear followed by garbage cannot be mistaken for a valid message.
inline bool validSyncJsonEnvelope(const char* data, size_t length) {
  bool string = false, opened = false, finished = false;
  unsigned depth = 0;
  for (size_t i = 0; i < length; ++i) {
    const char c = data[i];
    if (!c) return false;
    if (string) {
      if (uint8_t(c) < 0x20) return false;
      if (c == '\\') {
        if (++i >= length || !data[i]) return false;
        if (data[i] == 'u' && i + 4 < length && !memcmp(data + i + 1, "0000", 4)) return false;
      } else if (c == '"') string = false;
      continue;
    }
    const bool space = c == ' ' || c == '\t' || c == '\r' || c == '\n';
    if (finished) { if (!space) return false; continue; }
    if (!opened) {
      if (space) continue;
      if (c != '{') return false;
      opened = true; depth = 1; continue;
    }
    if (c == '"') string = true;
    else if (c == '{' || c == '[') { if (++depth > 8) return false; }
    else if (c == '}' || c == ']') { if (!--depth) finished = true; }
  }
  return opened && finished && !string;
}

// Accept a bounded RFC 3339 subset: explicit timezone, real dates, and up to 3
// fractional digits. Offset arithmetic is independent of the ESP's display timezone.
// Reference: https://www.rfc-editor.org/rfc/rfc3339#section-5.6
inline bool parseSyncTimestamp(const char* text, size_t length, SyncTimestamp& output) {
  if (!text || length < 20 || length > 29 || strnlen(text, 30) != length) return false;
  if (text[4] != '-' || text[7] != '-' || text[10] != 'T' || text[13] != ':' || text[16] != ':') return false;
  unsigned fields[6] = {0};
  const uint8_t starts[6] = {0, 5, 8, 11, 14, 17}, widths[6] = {4, 2, 2, 2, 2, 2};
  for (unsigned field = 0; field < 6; ++field) {
    for (unsigned i = 0; i < widths[field]; ++i) {
      const char digit = text[starts[field] + i];
      if (digit < '0' || digit > '9') return false;
      fields[field] = fields[field] * 10 + digit - '0';
    }
  }
  const uint32_t date = fields[0] * 10000U + fields[1] * 100U + fields[2];
  if (!validDate(date) || fields[3] > 23 || fields[4] > 59 || fields[5] > 59) return false;
  size_t position = 19;
  uint16_t fraction = 0;
  if (text[position] == '.') {
    const size_t start = ++position;
    while (position < length && text[position] >= '0' && text[position] <= '9') {
      if (position - start >= 3) return false;
      fraction = fraction * 10 + text[position++] - '0';
    }
    const size_t digits = position - start;
    if (!digits) return false;
    for (size_t i = digits; i < 3; ++i) fraction *= 10;
  }
  int32_t offset = 0;
  if (position + 1 == length && text[position] == 'Z') {
    // UTC is already canonical.
  } else {
    if (position + 6 != length || (text[position] != '+' && text[position] != '-') || text[position + 3] != ':') return false;
    for (unsigned i : {1U, 2U, 4U, 5U}) if (text[position + i] < '0' || text[position + i] > '9') return false;
    const unsigned hours = (text[position + 1] - '0') * 10 + text[position + 2] - '0';
    const unsigned minutes = (text[position + 4] - '0') * 10 + text[position + 5] - '0';
    if (hours > 14 || minutes > 59 || (hours == 14 && minutes) || (text[position] == '-' && !hours && !minutes)) return false;
    offset = int32_t(hours * 3600 + minutes * 60) * (text[position] == '+' ? 1 : -1);
  }
  const int64_t utc = int64_t(dateEpoch(date)) + fields[3] * 3600U + fields[4] * 60U + fields[5] - offset;
  if (utc < dateEpoch(20240101) || utc >= int64_t(dateEpoch(20991231)) + SECONDS_PER_DAY) return false;
  output.seconds = uint32_t(utc);
  output.milliseconds = fraction;
  return true;
}

// Copy mutable formatted text into the JSON document; no pointer to this stack survives.
inline void serializeSyncTimestamp(JsonObject root, const char* key, const SyncTimestamp& stamp) {
  if (!stamp.seconds) { root[key] = nullptr; return; }
  const uint32_t date = epochDate(stamp.seconds), time = stamp.seconds % SECONDS_PER_DAY;
  char text[32];
  if (stamp.milliseconds) snprintf(text, sizeof(text), "%04u-%02u-%02uT%02u:%02u:%02u.%03uZ",
    unsigned(date / 10000), unsigned(date / 100 % 100), unsigned(date % 100), unsigned(time / 3600), unsigned(time / 60 % 60), unsigned(time % 60), unsigned(stamp.milliseconds));
  else snprintf(text, sizeof(text), "%04u-%02u-%02uT%02u:%02u:%02uZ",
    unsigned(date / 10000), unsigned(date / 100 % 100), unsigned(date % 100), unsigned(time / 3600), unsigned(time / 60 % 60), unsigned(time % 60));
  root[key] = text;
}

// The raw envelope has already excluded NUL escapes at the first trust boundary.
inline bool readSyncTimestamp(JsonVariantConst value, SyncTimestamp& output) {
  if (!value.is<const char*>()) return false;
  const char* text = value.as<const char*>();
  return parseSyncTimestamp(text, strnlen(text, 30), output);
}

// A successful explicit null clears only this slot. Missing fields, extra settings,
// wrong types and parse errors are not equivalent to an empty alarm list.
inline bool parseSyncMessage(JsonObjectConst root, PhoneSyncMessage& message, const char*& error) {
  if (root.size() != 2 || !root.containsKey("capturedAt") || !root.containsKey("wakeAt")) { error = "invalid_sync_fields"; return false; }
  if (!readSyncTimestamp(root["capturedAt"], message.capturedAt)) { error = "invalid_captured_at"; return false; }
  message.wakeAt = SyncTimestamp();
  if (!root["wakeAt"].isNull() && (!readSyncTimestamp(root["wakeAt"], message.wakeAt) || message.wakeAt.milliseconds)) {
    error = "invalid_wake_at"; return false;
  }
  return true;
}

// A newer ordering watermark is persisted even when the wake time stays unchanged.
// Exact retries bypass age/past-time checks but never reset an execution marker.
inline SyncDecision stagePhoneSync(const PhoneSyncRecord& current, const PhoneSyncMessage& message, uint32_t now, bool validClock, PhoneSyncRecord& candidate) {
  SyncDecision result;
  if (message.capturedAt.value() < current.capturedAt.value()) { result.code = 409; result.error = "stale_sync"; return result; }
  if (message.capturedAt == current.capturedAt) {
    if (!(message.wakeAt == current.wakeAt)) { result.code = 409; result.error = "sync_conflict"; }
    return result;
  }
  if (!validClock) { result.code = 503; result.error = "time_not_set"; return result; }
  if (message.capturedAt.value() > (uint64_t(now) + SYNC_FUTURE_SKEW) * 1000) { result.code = 422; result.error = "captured_in_future"; return result; }
  if (uint64_t(message.capturedAt.seconds) + SYNC_MAX_CAPTURE_AGE < now) { result.code = 409; result.error = "capture_expired"; return result; }
  const bool consumed = message.wakeAt.seconds && message.wakeAt == current.wakeAt && message.wakeAt.seconds <= current.consumedThrough;
  if (message.wakeAt.seconds && !consumed) {
    if (message.wakeAt.seconds <= current.consumedThrough) { result.code = 409; result.error = "occurrence_consumed"; return result; }
    if (message.wakeAt.seconds <= now) { result.code = 422; result.error = "wake_in_past"; return result; }
    if (uint64_t(message.wakeAt.seconds) > uint64_t(now) + SYNC_MAX_LOOKAHEAD) { result.code = 422; result.error = "wake_too_far"; return result; }
  }
  candidate = current;
  candidate.capturedAt = message.capturedAt;
  candidate.wakeAt = message.wakeAt;
  if (!consumed) candidate.phase = message.wakeAt.seconds ? SyncPhase::Scheduled : SyncPhase::Empty;
  candidate.revision = advanceRevision(current.revision);
  result.changed = true;
  return result;
}

// Network access policy for the intentionally credential-free home-LAN API.
// Zero/IPv6-converted addresses and network/broadcast addresses do not qualify.
inline bool localSyncPeer(uint32_t peer, uint32_t local, uint32_t mask) {
  if (!peer || !local || !mask) return false;
  const uint32_t network = local & mask;
  return (peer & mask) == network && peer != network && peer != (network | ~mask);
}

// Settings use a separate revision and are not part of a phone's sync payload.
// copyFrom copies visual fields once, never a recurring date or execution marker.
inline SyncDecision stagePhoneProfile(JsonObjectConst root, const Config& manual, const PhoneSyncRecord& current, PhoneSyncRecord& candidate) {
  SyncDecision result;
  if (root.size() != 3 || !root["enabled"].is<bool>() || !root["revision"].is<uint32_t>() ||
      root.containsKey("profile") == root.containsKey("copyFrom")) { result.code = 422; result.error = "invalid_profile_fields"; return result; }
  if (root["revision"].as<uint32_t>() != current.profileRevision) { result.code = 409; result.error = "profile_revision_conflict"; return result; }
  Alarm profile = current.profile;
  if (root.containsKey("copyFrom")) {
    if (!root["copyFrom"].is<const char*>() || !validId(root["copyFrom"])) { result.code = 422; result.error = "invalid_copy_source"; return result; }
    bool found = false;
    for (uint8_t i = 0; i < manual.count; ++i) {
      if (strncmp(manual.alarms[i].id, root["copyFrom"].as<const char*>(), sizeof(profile.id))) continue;
      profile = manual.alarms[i]; found = true; break;
    }
    if (!found) { result.code = 404; result.error = "alarm_not_found"; return result; }
  } else {
    JsonObjectConst object = root["profile"];
    if (object.size() != 9 || !object["label"].is<const char*>() || !object["scene"].is<const char*>() ||
        !parseLightProfile(object, profile, false, result.error)) { result.code = 422; if (!result.error[0]) result.error = "invalid_profile_fields"; return result; }
  }
  candidate = current;
  candidate.enabled = root["enabled"];
  candidate.profile = profile;
  strcpy(candidate.profile.id, "iphone");
  candidate.profile.enabled = true;
  candidate.profile.weekdays = 0;
  candidate.profile.date = candidate.profile.lastDate = candidate.profile.skipDate = 0;
  candidate.profileRevision = advanceRevision(current.profileRevision);
  candidate.revision = advanceRevision(current.revision);
  result.changed = true;
  return result;
}

// The phone's explicit UTC instant is authoritative, including the second repeated
// DST hour. Do not round-trip it through the minute-only manual alarm scheduler.
inline Occurrence phoneSyncOccurrence(const PhoneSyncRecord& record, uint32_t now, const Clock& clock, bool dueOnly = false) {
  Occurrence result;
  if (!record.enabled || record.phase != SyncPhase::Scheduled || record.wakeAt.seconds <= record.consumedThrough) return result;
  const uint32_t wake = record.wakeAt.seconds;
  const uint32_t start = wake - record.profile.rampMinutes * 60U;
  const uint32_t end = wake + (record.profile.holdMinutes + record.profile.fadeMinutes) * 60U;
  if (!wake || now > wake + LATE_START_SECONDS || now >= end || (dueOnly && start > now)) return result;
  result.index = PHONE_ALARM_INDEX;
  result.date = epochDate(clock.toLocal(wake));
  result.start = start; result.wake = wake; result.end = end;
  return result;
}

// Manual alarms win an exact tie. The independent slot does not reduce the 16
// manual-alarm capacity and can be ignored independently after a storage failure.
inline Occurrence nextCombinedOccurrence(const Config& config, const PhoneSyncRecord& phone, uint32_t now, const Clock& clock,
    bool dueOnly = false, bool manualAllowed = true, bool phoneAllowed = true) {
  if (!config.enabled) return Occurrence();
  Occurrence manual = manualAllowed ? nextOccurrence(config, now, clock, dueOnly) : Occurrence();
  const Occurrence synced = phoneAllowed ? phoneSyncOccurrence(phone, now, clock, dueOnly) : Occurrence();
  return synced && (!manual || synced.start < manual.start) ? synced : manual;
}

// This candidate must be committed before starting LEDs or reporting a manual skip.
// The UTC watermark survives clears, profile edits and reboot.
inline bool stagePhoneConsumption(const PhoneSyncRecord& current, const Occurrence& occurrence, PhoneSyncRecord& candidate, SyncPhase phase = SyncPhase::Consumed) {
  if (occurrence.index != PHONE_ALARM_INDEX || !occurrence || occurrence.wake != current.wakeAt.seconds ||
      current.phase != SyncPhase::Scheduled || occurrence.wake <= current.consumedThrough) return false;
  candidate = current;
  candidate.consumedThrough = occurrence.wake;
  candidate.phase = phase;
  candidate.revision = advanceRevision(current.revision);
  return true;
}

inline const char* syncPhaseName(SyncPhase phase) {
  switch (phase) {
    case SyncPhase::Scheduled: return "scheduled";
    case SyncPhase::Consumed: return "consumed";
    case SyncPhase::Started: return "started";
    case SyncPhase::Completed: return "completed";
    case SyncPhase::Skipped: return "skipped";
    case SyncPhase::Stopped: return "stopped";
    case SyncPhase::Cancelled: return "cancelled";
    case SyncPhase::Interrupted: return "interrupted";
    default: return "empty";
  }
}

// Defensive NVS decoding validates structure and the replay watermark. The former
// credential-bearing schema can be read for migration, but its credentials are ignored.
// All related values live in one blob, so reboot cannot mix different sync revisions.
inline bool parsePhoneSyncRecord(JsonObjectConst root, PhoneSyncRecord& output, const char*& error) {
  uint32_t phase;
  const bool legacy = root["version"].is<uint8_t>() && root["version"] == 1;
  if (root.size() != (legacy ? 11U : 9U) || !root["version"].is<uint8_t>() || (!legacy && root["version"] != SYNC_VERSION) || !root["enabled"].is<bool>() ||
      !root["revision"].is<uint32_t>() || !root["profileRevision"].is<uint32_t>() ||
      !number(root["phase"], 0, unsigned(SyncPhase::Interrupted), phase) || !root["consumedThrough"].is<uint32_t>() ||
      !root.containsKey("capturedAt") || !root.containsKey("wakeAt") ||
      (legacy && (!root.containsKey("token") || !root.containsKey("tokenGeneration"))) ||
      !root["profile"].is<JsonObjectConst>()) { error = "sync_configuration_unreadable"; return false; }
  PhoneSyncRecord candidate;
  candidate.enabled = root["enabled"];
  candidate.revision = root["revision"];
  candidate.profileRevision = root["profileRevision"];
  candidate.consumedThrough = root["consumedThrough"];
  candidate.phase = SyncPhase(phase);
  if ((candidate.consumedThrough && !validDate(epochDate(candidate.consumedThrough))) ||
      (!root["capturedAt"].isNull() && !readSyncTimestamp(root["capturedAt"], candidate.capturedAt)) ||
      (!root["wakeAt"].isNull() && (!readSyncTimestamp(root["wakeAt"], candidate.wakeAt) || candidate.wakeAt.milliseconds)) ||
      (candidate.wakeAt.seconds && !candidate.capturedAt.seconds) ||
      ((candidate.phase == SyncPhase::Empty) != !candidate.wakeAt.seconds) ||
      (candidate.phase == SyncPhase::Scheduled && candidate.wakeAt.seconds <= candidate.consumedThrough) ||
      (candidate.phase != SyncPhase::Empty && candidate.phase != SyncPhase::Scheduled && candidate.phase != SyncPhase::Cancelled && candidate.wakeAt.seconds > candidate.consumedThrough) ||
      !parseLightProfile(root["profile"], candidate.profile, false, error)) { error = "sync_configuration_unreadable"; return false; }
  output = candidate;
  return true;
}

// Persist only schedule/profile data; there are no access credentials in this schema.
inline void serializePhoneSyncRecord(JsonObject root, const PhoneSyncRecord& record) {
  root["version"] = SYNC_VERSION;
  root["revision"] = record.revision;
  root["profileRevision"] = record.profileRevision;
  root["enabled"] = record.enabled;
  root["phase"] = unsigned(record.phase);
  root["consumedThrough"] = record.consumedThrough;
  serializeSyncTimestamp(root, "capturedAt", record.capturedAt);
  serializeSyncTimestamp(root, "wakeAt", record.wakeAt);
  serializeLightProfile(root.createNestedObject("profile"), record.profile);
}

} // namespace LightAlarm
// AI: end
