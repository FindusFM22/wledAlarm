#pragma once

#include "wled.h"
#include "light_alarm_model.h"
#include "light_alarm_atomic.h"
#include "light_alarm_probe_codec.h"
#include <lwip/etharp.h>
#include <lwip/raw.h>
#include <lwip/udp.h>
#include <netif/ethernet.h>
#ifdef ARDUINO_ARCH_ESP32
#include <lwip/tcpip.h>
#endif

// AI: below section was generated by an AI
namespace LightAlarm {

// Receive actual replies instead of accepting an old ARP cache entry. All PCB
// operations run in lwIP context. The input observer only inspects a bounded ARP
// header and forwards each original packet exactly once, without modifying it.
class UdpProbe {
  struct Interface {
    struct netif* pointer = nullptr;
    netif_input_fn forward = nullptr;
  };
  Interface _interfaces[2];
  Atomic<uint8_t> _interfaceCount {0};
  struct udp_pcb* _udp = nullptr;
  struct raw_pcb* _icmp = nullptr;
  Atomic<bool> _pending {false}, _active {false}, _cancelled {true}, _sent {false}, _arpAvailable {false};
  Atomic<uint8_t> _methods {0};
  Atomic<uint8_t> _sends {0};
  Atomic<uint32_t> _epoch {0};
  uint32_t _queuedEpoch = 0;
  Atomic<uint32_t> _targetNative {0}, _target {0}, _local {0}, _since {0}, _replyTime {0};
  Atomic<uint16_t> _sourcePort {0}, _token {0};
  uint8_t _question[64] = {0};
  size_t _questionSize = 0;

  // There is one statically registered alarm usermod. Initialize this before
  // installing callbacks; the pointer is immutable for the firmware lifetime.
  static UdpProbe*& instance() { static UdpProbe* probe = nullptr; return probe; }

  bool accepts() const { return _active.load() && !_cancelled.load() && uint32_t(millis() - _since.load()) < PresenceBurst::RECEIVE_WINDOW_MS; }
  void received(uint8_t method, uint32_t epoch) {
    if (!accepts() || _epoch.load() != epoch) return;
    _replyTime = millis();
    _methods.fetch_or(method);
  }

  static err_t input(struct pbuf* packet, struct netif* interface) {
    UdpProbe* self = instance();
    netif_input_fn forward = nullptr;
    if (self) {
      for (uint8_t i = 0; i < self->_interfaceCount.load(); ++i) {
        if (self->_interfaces[i].pointer == interface) { forward = self->_interfaces[i].forward; break; }
      }
      if (packet && self->accepts() && interface && interface->hwaddr_len == 6 && packet->tot_len >= 42) {
        const uint32_t epoch = self->_epoch.load();
        uint8_t header[42];
        if (pbuf_copy_partial(packet, header, sizeof(header), 0) == sizeof(header) &&
            Probe::arpReply(header, sizeof(header), self->_target.load(), self->_local.load(), interface->hwaddr)) self->received(Probe::ARP, epoch);
      }
    }
    if (forward) return forward(packet, interface);
    // A normal callback cannot reach this branch: its immutable forwarding slot
    // is published before installation. Keep an exceptional packet on the standard path.
#ifdef ARDUINO_ARCH_ESP32
    return tcpip_input(packet, interface);
#else
    return ethernet_input(packet, interface);
#endif
  }

  bool observeInterface(struct netif* interface) {
    if (!interface || !interface->input || interface->hwaddr_len != 6) return false;
    const uint8_t count = _interfaceCount.load();
    for (uint8_t i = 0; i < count; ++i) {
      if (_interfaces[i].pointer != interface) continue;
      // Reinstall after a standard netif restart, but never take over another
      // module's custom wrapper (which could otherwise form a forwarding cycle).
      if (interface->input == _interfaces[i].forward) interface->input = input;
      return interface->input == input;
    }
    if (count >= 2 || interface->input == input) return false;
    _interfaces[count].pointer = interface;
    _interfaces[count].forward = interface->input;
    _interfaceCount = count + 1;
    interface->input = input;
    return true;
  }

  static void udpReceive(void* arg, struct udp_pcb*, struct pbuf* packet, const ip_addr_t* address, u16_t port) {
    auto* self = static_cast<UdpProbe*>(arg);
    if (packet && address && self->accepts() && IP_IS_V4(address) && ip_2_ip4(address)->addr == self->_targetNative.load() &&
        port == Probe::MDNS_PORT && packet->tot_len >= 12 && packet->tot_len <= 512) {
      const uint32_t epoch = self->_epoch.load();
      uint8_t data[512];
      const size_t size = packet->tot_len;
      if (pbuf_copy_partial(packet, data, size, 0) == size &&
          Probe::mdnsReply(data, size, self->_target.load(), self->_token.load())) self->received(Probe::MDNS, epoch);
    }
    // UDP delivers ownership to this callback; unlike the input observer, it must free it.
    if (packet) pbuf_free(packet);
  }

  static u8_t icmpReceive(void* arg, struct raw_pcb*, struct pbuf* packet, const ip_addr_t* address) {
    auto* self = static_cast<UdpProbe*>(arg);
    if (packet && address && self->accepts() && self->_sent.load() && IP_IS_V4(address) &&
        ip_2_ip4(address)->addr == self->_targetNative.load()) {
      const uint32_t epoch = self->_epoch.load();
      uint8_t data[160];
      const size_t size = min(size_t(packet->tot_len), sizeof(data));
      if (pbuf_copy_partial(packet, data, size, 0) == size &&
          Probe::portUnreachable(data, size, self->_target.load(), self->_local.load(), self->_sourcePort.load(), self->_token.load())) self->received(Probe::ICMP, epoch);
    }
    return 0; // Do not consume ICMP: normal ping sessions and the IP stack still need it.
  }

  static void send(void* arg) {
    auto* self = static_cast<UdpProbe*>(arg);
    if (self->_cancelled.load() || self->_queuedEpoch != self->_epoch.load()) { self->_pending = false; return; }
    ip_addr_t target;
    IP_ADDR4(&target, self->_target.load() >> 24, self->_target.load() >> 16 & 255,
      self->_target.load() >> 8 & 255, self->_target.load() & 255);
    struct netif* interface = nullptr;
    for (struct netif* candidate = netif_list; candidate; candidate = candidate->next) {
      const uint32_t local = Probe::read32(reinterpret_cast<const uint8_t*>(&netif_ip4_addr(candidate)->addr));
      if (local == self->_local.load()) { interface = candidate; break; }
    }
    if (!self->_udp) {
      self->_udp = udp_new();
      if (self->_udp && udp_bind(self->_udp, IP_ADDR_ANY, 0) == ERR_OK) {
        self->_udp->ttl = 255; // RFC 6762 local-link TTL.
        udp_recv(self->_udp, udpReceive, self);
      } else {
        if (self->_udp) udp_remove(self->_udp);
        self->_udp = nullptr;
      }
    }
    if (!self->_icmp) {
      self->_icmp = raw_new(1); // IPv4 ICMP.
      if (self->_icmp) raw_recv(self->_icmp, icmpReceive, self);
    }
    self->_arpAvailable = self->observeInterface(interface);
    if (self->_cancelled.load() || self->_queuedEpoch != self->_epoch.load()) { self->_pending = false; return; }
    if (!self->_active.load()) self->_since = millis(); // Retries keep the original receive window/token.
    self->_active = true;
    if (self->_udp) {
      self->_sourcePort = self->_udp->local_port;
      struct pbuf* packet = pbuf_alloc(PBUF_TRANSPORT, self->_questionSize, PBUF_RAM);
      if (packet) {
        if (pbuf_take(packet, self->_question, self->_questionSize) == ERR_OK) {
          const bool previous = self->_sent.load();
          self->_sent = true; // Publish before sending: an immediate ICMP error must be matchable.
          if (udp_sendto(self->_udp, packet, &target, Probe::MDNS_PORT) == ERR_OK) self->_sends++;
          else self->_sent = previous;
        }
        pbuf_free(packet);
      }
    }
    if (interface) etharp_request(interface, ip_2_ip4(&target));
    self->_pending = false;
  }

public:
  void begin() { instance() = this; }
  void clear() { stop(); _methods = 0; _sent = false; _arpAvailable = false; _sends = 0; }

  // Small buffers/PCBs are allocated once and reused. No radio probing happens
  // outside a requested round, even though the passive callbacks remain installed.
  bool start(const IPAddress& target, const IPAddress& local) {
    if (_pending.exchange(true)) return false;
    stop();
    _queuedEpoch = _epoch.load();
    _cancelled = false;
    _sent = _arpAvailable = false;
    _methods = 0;
    _sends = 0;
    _replyTime = 0;
    _targetNative = uint32_t(target);
    _target = (uint32_t(target[0]) << 24) | (uint32_t(target[1]) << 16) | (uint32_t(target[2]) << 8) | target[3];
    _local = (uint32_t(local[0]) << 24) | (uint32_t(local[1]) << 16) | (uint32_t(local[2]) << 8) | local[3];
    _token = hw_random16() | 1U;
    _questionSize = Probe::mdnsQuestion(_question, sizeof(_question), _target.load(), _token.load());
    if (!_questionSize) { _pending = false; return false; }
#ifdef ARDUINO_ARCH_ESP32
    if (tcpip_callback(send, this) != ERR_OK) { _pending = false; return false; }
#else
    send(this);
#endif
    return true;
  }

  // Re-query within the same round. Do not reset evidence, the DNS transaction,
  // generation or receive window: a delayed reply to the first packet is still valid.
  bool resend() {
    if (_cancelled.load() || _pending.exchange(true)) return false;
    _queuedEpoch = _epoch.load();
#ifdef ARDUINO_ARCH_ESP32
    if (tcpip_callback(send, this) != ERR_OK) { _pending = false; return false; }
#else
    send(this);
#endif
    return true;
  }

  void stop() { _cancelled = true; _active = false; _epoch++; }
  bool pending() const { return _pending.load(); }
  bool sent() const { return _sent.load(); }
  bool arpAvailable() const { return _arpAvailable.load(); }
  uint8_t methods() const { return _methods.load(); }
  uint8_t sends() const { return _sends.load(); }
  uint32_t replyTime() const { return _replyTime.load(); }
};

} // namespace LightAlarm
// AI: end
